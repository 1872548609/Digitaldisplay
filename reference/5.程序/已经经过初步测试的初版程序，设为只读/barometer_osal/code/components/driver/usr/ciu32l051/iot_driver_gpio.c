/**************************************************************************************************
Filename:       iot_driver_gpio.c
Revised:        $Date: 2019-8-20 15:35
Revision:       $Revision: V1.0.0

Description:

Copyright 2021 uwaycon. All rights reserved.
                                                
**************************************************-*****************^******************************/

#ifdef __cplusplus
extern "C"
{
#endif

/*************************************************-*************************************************
*                                               NOTE
**************************************************-*****************^******************************/
//-- source insight use UTF-8 to encode, File->Reload As Encoding...->UTF-8
//-- source insight set default encode, Option->Preferences->Files->Default encoding->UTF-8

/*************************************************-*************************************************
*                                             INCLUDES
**************************************************-*****************^******************************/
#include "iot_driver_gpio.h"

/*************************************************-*************************************************
*                                               MACRO
**************************************************-*****************^******************************/

/*************************************************-*************************************************
*                                          CONSTANT DEFINED
**************************************************-*****************^******************************/

/*************************************************-*************************************************
*                                           STRUCT DEFINED
**************************************************-*****************^******************************/

/*************************************************-*************************************************
*                                          GLOBAL VARIABLES
**************************************************-*****************^******************************/

/*************************************************-*************************************************
*                                          LOCAL VARIABLES
**************************************************-*****************^******************************/

/*************************************************-*************************************************
*                                          LOCAL VARIABLES
**************************************************-*****************^******************************/

/*************************************************-*************************************************
*                                             FUNCTIONS
**************************************************-*****************^******************************/

/*************************************************-*************************************************
*                                             FUNCTIONS
**************************************************-*****************^******************************/
void iot_driver_gpio_init_input(GPIO_t *port, uint32_t pin)
{
    /* 使能LED1对应的GPIO时钟 */
    if (port == GPIOA)
    {
        std_rcc_gpio_clk_enable(RCC_PERIPH_CLK_GPIOA);
    }
    else if (port == GPIOB)
    {
        std_rcc_gpio_clk_enable(RCC_PERIPH_CLK_GPIOB);
    }
    else if (port == GPIOC)
    {
        std_rcc_gpio_clk_enable(RCC_PERIPH_CLK_GPIOC);
    }
    
    std_gpio_init_t led_gpio_init = {0};

    /* 配置LED1的IO */
    led_gpio_init.pin = pin;
    led_gpio_init.mode = GPIO_MODE_INPUT;
    led_gpio_init.pull = GPIO_PULLUP;
    led_gpio_init.output_type = GPIO_OUTPUT_PUSHPULL;

    /* 初始化GPIO */
    std_gpio_init(port, &led_gpio_init);
}

void iot_driver_gpio_init_output(GPIO_t *port, uint32_t pin)
{
    /* 使能LED1对应的GPIO时钟 */
    if (port == GPIOA)
    {
        std_rcc_gpio_clk_enable(RCC_PERIPH_CLK_GPIOA);
    }
    else if (port == GPIOB)
    {
        std_rcc_gpio_clk_enable(RCC_PERIPH_CLK_GPIOB);
    }    
    else if (port == GPIOC)
    {
        std_rcc_gpio_clk_enable(RCC_PERIPH_CLK_GPIOC);
    }
    else if (port == GPIOD)
    {
        std_rcc_gpio_clk_enable(RCC_PERIPH_CLK_GPIOD);
    }
    
    std_gpio_init_t led_gpio_init = {0};

    /* 配置LED1的IO */
    led_gpio_init.pin = pin;
    led_gpio_init.mode = GPIO_MODE_OUTPUT;
    led_gpio_init.pull = GPIO_PULLUP;
    led_gpio_init.output_type = GPIO_OUTPUT_PUSHPULL;

    /* 初始化GPIO */
    std_gpio_init(port, &led_gpio_init);
}

/*************************************************-*************************************************
*                                                END
**************************************************-*****************^******************************/
#ifdef __cplusplus
}
#endif
 
